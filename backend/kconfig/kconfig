## backend/kconfig/kconfig
```kconfig
mainmenu "Kconfig configuration"

menu "LED STATUS"
config LED_STATUS
	string "LED status configuration"
	default "green:status"
	help
	  Enter the status LED configuration string. 
endmenu

menu "LED NETWORK"
config LED_NETWORK
	string "LED network configuration"
	default "red:power"
	help
	  Enter the network LED configuration string. 
endmenu
```
